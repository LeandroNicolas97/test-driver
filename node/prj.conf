## CMakeLists.txt
```
# Find Zephyr. This also loads Zephyr's build system.
cmake_minimum_required(VERSION 3.26.3)
if(NOT DEFINED BOARD)
  set(BOARD oxycontroller4_samd21)
endif()
find_package(Zephyr REQUIRED HINTS $ENV{ZEPHYR_BASE})
project(my_zephyr_app)

set(MICROLIB_DIR "../deps/microlib2")
set(MICROLIB_ARCH "zephyr")
include("${MICROLIB_DIR}/CMakeLists.txt")

# Get the current version from git
execute_process(COMMAND git describe
        #WORKING_DIRECTORY "${MICROLIB}"
        OUTPUT_VARIABLE "PROJECT_VERSION_STRING")
string(STRIP ${PROJECT_VERSION_STRING} PROJECT_VERSION_STRING)

# This should give the includes, options and defines from Zephyr
# to be used to compile our external libraries, but for some
# reason they have some quotes which make the variables not
# usable.
zephyr_get_include_directories_for_lang(       C includes STRIP_PREFIX)
zephyr_get_system_include_directories_for_lang_as_string(C system_includes STRIP_PREFIX)
zephyr_get_compile_definitions_for_lang(       C definitions STRIP_PREFIX)
zephyr_get_compile_options_for_lang(C options_xxx STRIP_PREFIX)
set(options "SHELL: ${options_xxx}")

# Show the info about our project
message("Project: ${PROJECT_NAME}")
message("Microlib acrhitecture ${MICROLIB_ARCH}")
message("Microlib version: ${MICROLIB_VERSION_STRING}")
message("Project version: ${PROJECT_VERSION_STRING}")
message("BSP include dir: ${BSP_INCLUDE}")
message("Board: ${BOARD}")
message("Options: ${options_xxx}")
message("Includes: ${includes}")
message("Definitions: ${definitions}")
message("SNIPPET_ROOT is set to: ${SNIPPET_ROOT}")


# Generate version file
configure_file(src/version.h.in version.h)

#add_library(driverlib STATIC
#    ${MICROLIB_ARCH_DIR}/serial.c
#)

# For some reason, fortify is not working correctly on MacOS
zephyr_compile_options(-U_FORTIFY_SOURCE)

list(REMOVE_ITEM MICROLIB_SOURCES 
    ${MICROLIB_SRC}/temperature_thermistor.c
    ${MICROLIB_SRC}/circular_object_storage.c
    ${MICROLIB_SRC}/luminescence_sensor.c
    ${MICROLIB_SRC}/oxygen_optic_ui.c
    )
add_library(microlib STATIC ${MICROLIB_SOURCES})

target_include_directories(microlib PUBLIC "${MICROLIB_INCLUDE_DIR}" "${BOARD_INCLUDE}" "${PROJECT_BINARY_DIR}" src)
# Options for compiling the microlib. 
# Actually This should be possible to get from Zephyr, but for
# some strange reason, they are corrupetd with some quotes.
set(MICROLIB_FLAGS -mcpu=cortex-m0plus -mthumb -mabi=aapcs -U_FORTIFY_SOURCE)

# Get optimization flag from Zephyr config
if(DEFINED CONFIG_COMPILER_OPT)
  # Extract just the optimization flag from CONFIG_COMPILER_OPT
  string(REGEX MATCH "-O[0-9s]" OPT_FLAG "${CONFIG_COMPILER_OPT}")
  if(OPT_FLAG)
    list(APPEND MICROLIB_FLAGS ${OPT_FLAG})
  endif()
else()
  # Default optimization if not specified
  list(APPEND MICROLIB_FLAGS -Os)
endif()

# Apply the flags to microlib
target_compile_options(microlib PRIVATE ${MICROLIB_FLAGS})
#target_compile_options(microlib PUBLIC ${options} -U_FORTIFY_SOURCE) 
#target_compile_definitions(microlib PUBLIC ${definitions})

target_include_directories(app PUBLIC "${MICROLIB_INCLUDE_DIR}" "${BSP_INCLUDE}" "${BOARD_INCLUDE}" "${PROJECT_BINARY_DIR}" src)
target_include_directories(microlib PUBLIC include)
target_link_libraries(app PUBLIC microlib)

# Sources for the smart sensor
set(SMART_SENSOR_SOURCES
        src/smart_sensors/smart_sensor_protocol.c
        src/smart_sensors/smart_sensor_innovex.c
        src/smart_sensors/smart_sensor_communication.c
        src/smart_sensors/smart_sensor_driver.c
        src/smart_sensors/smart_sensor_operations.c
        src/smart_sensors/smart_sensor_yosemitech.c
        src/smart_sensors/smart_sensor_ponsel.c
        src/smart_sensors/smart_sensor_ysi.c
        src/smart_sensors/smart_sensor_gps_pa1010d.c
        src/smart_sensors/smart_sensor_vaisala.c
        src/smart_sensors/smart_sensor_lufft.c
        src/smart_sensors/smart_sensor_huizhong.c
        src/smart_sensors/smart_sensor_signature_flow.c
        src/smart_sensors/smart_sensor_jiangsu_flow.c
        src/smart_sensors/smart_sensor_anb.c
        src/smart_sensors/smart_sensor_tds100.c
        src/smart_sensors/smart_sensor_chemins.c
        src/smart_sensors/smart_sensor_seabird.c
        src/smart_sensors/smart_sensor_signature_nortek.c
        src/smart_sensors/parsing_signature_nortek.c
        src/smart_sensors/smart_sensor_xm126.c
        src/smart_sensors/smart_sensor_aquadopp_nortek.c
        src/smart_sensors/smart_sensor_flowquest.c
        src/smart_sensors/parsing_flowquest.c
        src/smart_sensors/smart_sensor_wtvb01.c
)

# Add your source file to the "app" target. This must come after
# find_package(Zephyr) which defines the target.
target_sources(app PRIVATE
    src/main.c
    src/oxycontroller_ui.c
    src/sampling.c
    src/modbus.c
    src/measurement_operations.c
    src/shell_commands.c
    src/ui_valves.c
    src/oxygen_control.c
    src/comunication.c
    src/arch/zephyr/sensor_power_hw.c
    src/arch/zephyr/radio.c
    src/arch/zephyr/configuration.c
    src/arch/zephyr/solenoid_pca9538.c
    src/arch/zephyr/local_sensors.c
    src/arch/zephyr/watchdog.c
    src/arch/zephyr/measurement_storage.c
    src/soc/samd21/adc.c
    src/satellite_compression.c
    ${SMART_SENSOR_SOURCES}
    ${MICROLIB_ARCH_DIR}/serial.c
    ${MICROLIB_ARCH_DIR}/timing.c
    ${MICROLIB_ARCH_DIR}/lcdio.c
    ${MICROLIB_ARCH_DIR}/led-hw.c
    ${MICROLIB_ARCH_DIR}/power_hw.c
    ${MICROLIB_DIR}/src/multishell.c
    ${MICROLIB_DRIVERS_DIR}/display_driver_dog.c)
if (CONFIG_EXTERNAL_DATALOGGER)
    target_sources(app PRIVATE
        src/arch/zephyr/external_datalogger.c)
endif ()
```

## prj.conf
```kconfig
# Core Configuration
CONFIG_MAIN_STACK_SIZE=8192
CONFIG_SYSTEM_WORKQUEUE_STACK_SIZE=2048
CONFIG_HEAP_MEM_POOL_SIZE=512
CONFIG_STDOUT_CONSOLE=y
CONFIG_NEWLIB_LIBC=y

# Power Management
CONFIG_PM=y
CONFIG_PM_DEVICE=y
CONFIG_PM_DEVICE_RUNTIME=y

# Memory and Flash
CONFIG_FLASH=y
CONFIG_FLASH_PAGE_LAYOUT=y
CONFIG_FLASH_MAP=y
CONFIG_NVS=y
CONFIG_MPU_ALLOW_FLASH_WRITE=y
#CONFIG_SOC_FLASH_SAM0_EMULATE_BYTE_PAGES=y
#CONFIG_DISK_DRIVER_FLASH=y

# Logging
CONFIG_LOG=n
CONFIG_LOG_MODE_MINIMAL=n
CONFIG_ADC_LOG_LEVEL_DBG=n

# Watchdog Timer
CONFIG_WATCHDOG=y
CONFIG_WDT_SAM0=y

# USB Configuration
# CONFIG_USB_DEVICE_STACK=y
# CONFIG_USB_DEVICE_PRODUCT="Zephyr MSC sample"
# CONFIG_USB_DEVICE_PID=0x0008
# CONFIG_USB_DRIVER_LOG_LEVEL_ERR=y
# CONFIG_USB_DEVICE_LOG_LEVEL_ERR=y
# CONFIG_USB_MASS_STORAGE=y
# CONFIG_USB_MASS_STORAGE_LOG_LEVEL_ERR=y
# CONFIG_USB_DEVICE_INITIALIZE_AT_BOOT=n  # Keeps USB Mounted
# CONFIG_APP_MSC_STORAGE_FLASH_FATFS=y

# Sensors and Interfaces
CONFIG_SENSOR=y
CONFIG_SI7006=y
CONFIG_GPIO_PCA953X=y
CONFIG_GPIO=y
CONFIG_ADC=y
CONFIG_ADC_SAM0=y

# Communication Interfaces
CONFIG_UART_INTERRUPT_DRIVEN=y
CONFIG_SPI=y
CONFIG_I2C=y
CONFIG_I2C_SAM0=y
CONFIG_LORA=y
CONFIG_LORA_SX127X=y
CONFIG_SPI_NOR=y
CONFIG_SPI_NOR_FLASH_LAYOUT_PAGE_SIZE=4096

# Miscellaneous
CONFIG_REBOOT=y
CONFIG_HWINFO=y
CONFIG_CBPRINTF_FP_SUPPORT=y

#Optimization
CONFIG_COMPILER_OPT="-Os"
```

## disable-sst25.overlay
```dts
&sst25vf032b {
	status="disabled";
};
```

## src/main.c
```c
/**
 *  \file oxycontroller.c
 *  \brief Concentrator for different sensors and controller
 *
 *  \author Pablo Santamarina Cuneo
 *  \date 26 October 2009
 *
 *  Copyright 2009-2021 Innovex Tecnologias Ltda. All rights reserved.
 */

#include <zephyr/kernel.h>
#include <string.h>
#include <zephyr/sys/printk.h>
#include <zephyr/pm/policy.h>
#include <zephyr/drivers/spi.h>
#include <zephyr/drivers/lora.h>
#include <zephyr/device.h>
#include <zephyr/devicetree.h>
#include <zephyr/drivers/uart.h>
#include <zephyr/pm/state.h>
#include "configuration.h"
#include "hardware.h"
#include "measurement.h"
#include "serial.h"
#include "microio.h"
#include "smart_sensor.h"
#include "sensor_power_hw.h"
#include "display_fb.h"
#include "bsp-config.h"
#include "debug.h"
#include "userinterface.h"
#include "radio.h"
#include "led.h"
#include "multishell.h"
#include "shell_commands.h"
#include "actual_conditions.h"
#include "sampling.h"
#include "oxygen_control.h"
#include "solenoid.h"
#include "adc.h"
#include "local_sensors.h"
#include "watchdog.h"
#include "measurement_storage.h"
#include "comunication.h"
#if CONFIG_EXTERNAL_DATALOGGER
#include "external_datalogger.h"
#include "compressed_measurement.h"
#endif

/* Local prototypes */
static void serialize_and_send_measurements(char *data, size_t size);
static void processes_init(void);
static void should_wake(int tics);
static void serialiaze_and_send_node(void);
/* static const struct device *get_si7006_device(void); */

/* This has to be defined for DEBUG to work */
/* enum debug_level debug_level = DEBUG_LEVEL_NO_MESSAGES; */
enum debug_level debug_level = DEBUG_LEVEL_DEBUG;

/*
 * Device state
 */
struct oxycontroller_state actual_state = {
    .warm_starts = 0,
    .total_scans = 0,
    .calib_pressed = 0,
    .quick_response = 0,
    .n_of_sensors_detected = 0,
    .display_on = 1,
    .has_solenoid_control = 0,
    .start_testing = 0,
    .uptime_at_last_ping = 0,
    .can_sleep = 0,
    .coordinator_found = 0,
    .missed_conection = 0,
    .using_external_memory = 0,

};

struct measurement actual_measurements[MAX_EXTERNAL_SENSORS + 1 + MAX_N_VALVES];
struct measurement node_measurement;
struct measurement valve_measurements[MAX_N_VALVES];
static uint32_t time_of_last_measurement; /* zero-initialized by C */
const struct device *si7007_dev;

int main(void)
{
    uint8_t radio_state = SLEEPING;

    processes_init();
    display_set_auto_flush(0);
    led_off(0);
    uint32_t elapsed = 0;

    while (1) {
        if (should_start_sampling(cfg.sampling_interval)) {
            /* Wait for local command */
            should_wake(2000000);
            display_driver_periodic_refresh();
            DEBUG("Sampling...\n");
            sensor_power_on(smart_sensors_detect_voltage());
            watchdog_reset();
            sleep_microseconds(500000);
            led_on(0);
            sampling(3, actual_state.n_of_sensors_detected, actual_measurements);
            time_of_last_measurement = get_current_time();
            if (!smart_sensors_detect_voltage()) {
                check_oxygen_levels_all_valves(cfg.use_saturation, actual_measurements);
            }
            acquire_local_sensors(&node_measurement, valve_measurements);
            sensor_power_off(smart_sensors_detect_voltage());
            /* Start radio communication */
            char data[255];

            if (check_for_adcp()) {
                struct smart_sensor *s = smart_sensor_get(0);

                send_adcp_measurements(time_of_last_measurement, s->manufacturer);
                serialiaze_and_send_node();
            } else {
                send_ping();
                serialize_and_send_measurements(data, sizeof(data));
            }

            radio_state = if_received_data(data);
            if (radio_state == RECEIVING) {
                radio_state = receiving_commands(data);
            }
            init_and_clear_lcd();
            display_end_device_status(node_measurement.node.battery_voltage);
            display_all_measurements(actual_state.n_of_sensors_detected, actual_measurements, cfg.use_saturation);
            display_flush();
            sensor_power_off(smart_sensors_detect_voltage());
            led_off(0);
            rs485_sleep(UART_SMART_SENSOR);
#if CONFIG_EXTERNAL_DATALOGGER
            int total_measurements = actual_state.n_of_sensors_detected;
            struct compressed_measurement_list *list = k_malloc(256);
            int compressed_size;

            compressed_size = compress_measurement_list(actual_measurements, total_measurements, 256, list);
            list->timestamp = time_of_last_measurement;
            DEBUG("Storing %i bytes from actual_measurements\n", compressed_size);
            watchdog_reset();
            datalogger_append((uint8_t *)list, 256);
            k_free(list);
            /* DEBUG("Free space: %i\n", datalogger_get_free_space()); */
#endif
            elapsed = k_uptime_get();
            DEBUG("--- elapsed: %i\n", elapsed); /* in msec */
            DEBUG("Sleeping for %iseg\n", cfg.sampling_interval);
        } else {
            int32_t sleep_time = k_uptime_get() - elapsed;
            uint32_t interval = 1000 * ((cfg.sampling_interval * 1000) - sleep_time);

            if (sleep_time > (cfg.sampling_interval * 1000)) {
                interval = 0;
            }
            if (interval < 0 || interval > (cfg.ping_interval * 1000000)) {
                interval = cfg.ping_interval * 1000000;
            }
            display_flush();
            watchdog_disable();
            sleep_microseconds(interval);
            watchdog_init();
            if (cfg.sampling_interval > cfg.ping_interval) {
                send_ping();
            }
        }
    }
    return 0;
}

static void processes_init(void)
{
    leds_init();
    led_on(0);
    serial_init(UART_SMART_SENSOR, 9600, 0, 0, 0);
    serial_init(COMM_UART, 11520, 0, 0, 0);
    microio_init(COMM_UART, COMM_UART);
    radio_init();
    adc_init();
    watchdog_init();
    /* INJECTION */
    int status = solenoid_init();

    DEBUG("Solenoid init %i\n", status);
    if (status == SOLENOID_OK) {
        actual_state.has_solenoid_control = 1;
    }
    oxygen_control_init(&(cfg.valve[0]));
    solenoid_release();

    read_nvs_data();

    if (cfg.n_changes < 0) {
        set_default_configuration();
        valves_set_default_configuration();
    }
    shell_init(command_list, cfg.name);
    init_and_clear_lcd();
    display_welcome_message();
    watchdog_disable();
    sleep_microseconds(1000000);
    display_clear();
    display_flush();
    display_set_auto_flush(1);

    if (sen_drv.n_changes < 0) {
        set_driver_default();
    }

    detect_sensors();
    processes_init_complete();
}

static void serialize_and_send_measurements(char *data, size_t size)
{
    size_t n_size = 110;
    int n_active_valves = 0;
    struct smart_sensor s;
    int sensor_number = 0;
    /* send valves measurements here if they are active */
    actual_measurements[actual_state.n_of_sensors_detected] = node_measurement;
    for (int i = 0; i < MAX_N_VALVES; i++) {
        if (cfg.valve[i].is_active) {
            n_active_valves++;
            actual_measurements[actual_state.n_of_sensors_detected + n_active_valves] = valve_measurements[i];
        }
    }
    /* add n_of_sensors_detected+1 for NODE measurement */
    for (int i = (actual_state.n_of_sensors_detected + n_active_valves); i >= 0; --i) {
        if (i >= actual_state.n_of_sensors_detected) {
            sensor_number = actual_measurements[i].sensor_number;
        } else if (i < actual_state.n_of_sensors_detected) {
            s = *smart_sensor_get(i);
            sensor_number = s.number;
        }
        int pos = usnprintf(data, size, ":%u:%s:%i:", time_of_last_measurement, cfg.name, sensor_number);

        serialize_measurement(&(actual_measurements[i]), 255, &(data[pos]));
        if (i == actual_state.n_of_sensors_detected) {
            if (is_channel_free()) {
                send_frame(data, size);
                check_acknowledgment(data, cfg.name, time_of_last_measurement);
            }
        } else {
            measurement_storage_append(data, n_size);
        }
    }
    if (is_channel_free()) {
        send_data_from_storage(time_of_last_measurement);
    }
}

static void should_wake(int tics)
{
    const struct device *dev = DEVICE_DT_GET(DT_CHOSEN(zephyr_console));
    uint8_t c;

    printk("Wake?\n");
    for (int j = 0; j < tics; ++j) {
        watchdog_reset();
        while (uart_poll_in(dev, &c) >= 0) {
            shell_char_received(c);
        }
    }
    while (cfg.command_state == WAKE) {
        watchdog_reset();
        while (uart_poll_in(dev, &c) >= 0) {
            shell_char_received(c);
        }
    }
    printk("Timeout\n");
}

int cmd_debug_level(char *str)
{
    if (!str) {
        printk("Debug %i\n", debug_level);
    } else {
        if (!strcmp("on", str)) {
            debug_level = DEBUG_LEVEL_DEBUG;
            printk("Debug activado\n");
        } else if (!strcmp("off", str)) {
            debug_level = DEBUG_LEVEL_NO_MESSAGES;
            printk("Debug desactivado\n");
        } else {
            printk("Enter on or off\n");
        }
    }
    return 0;
}

int detect_sensors(void)
{
    configure_sensor_drivers();
    int rc = measurement_storage_mount();

    if (rc != 0) {
        DEBUG("Measurement storage mount error: %i\n", rc);
    }
#if CONFIG_EXTERNAL_DATALOGGER
    rc = datalogger_mount();
    if (rc == 0) {
        DEBUG("External memory mount OK\n");
    } else {
        DEBUG("External memory mount ERROR %i\n", rc);
    }
#endif
    local_sensors_init();
    int status = sensor_power_init();

    DEBUG("Sensor power status %i\n", status);

    if (actual_state.has_solenoid_control) {
        detect_all_valves();
    } else {
        display_printf("No solenoid control.\n");
    }
    if (cfg.command_state == SLEEP) {
        should_wake(2000000);
    }
    watchdog_init();
    restore_meas_unit_flag();
    sensor_power_on(smart_sensors_detect_voltage());
    actual_state.n_of_sensors_detected = smart_sensors_detect_all();
    sensor_power_off(smart_sensors_detect_voltage());

    return 0;
}

static void serialiaze_and_send_node(void)
{
    char buffer[256];
    int pos = usnprintf(
        buffer, sizeof(buffer), ":%u:%s:%i:", time_of_last_measurement, cfg.name, node_measurement.sensor_number);
    serialize_measurement(&node_measurement, 255, &(buffer[pos]));
    if (is_channel_free()) {
        send_frame(buffer, 255);
        check_acknowledgment(buffer, cfg.name, time_of_last_measurement);
    }
}
```

## include/actual_conditions.h
```c
#ifndef _ACTUAL_CONDITIONS_H
#define _ACTUAL_CONDITIONS_H

#include "measurement.h"
#include "bsp-config.h"

#define WAKE  1
#define SLEEP 0
/**
 * The actual state of the device.
 * All state information should be packed here.
 */
struct oxycontroller_state {
    uint32_t warm_starts;          /* Number of warm starts */
    uint32_t total_scans;          /* Number of scans that we have performed */
    uint8_t calib_pressed;         /* How many seconds has the calibration button been pressed */
    uint16_t quick_response;       /* Number of times to respond quickly */
    uint8_t link_quality;          /* The current link quality */
    uint8_t n_of_sensors_detected; /* Number of sensors detected during start up */
    uint8_t display_on;            /* True to keep the display ON */
    uint8_t has_solenoid_control;  /* True if the solenoid control (i2C chip) is connected */
    uint8_t start_testing;         /* XXX */
    uint32_t uptime_at_last_ping;
    uint8_t can_sleep; /* Indicate the device can sleep immediately */
    uint8_t coordinator_found;
    uint32_t missed_conection;     /* Number of NAKs since last confirmed reception */
    uint8_t using_external_memory; /* True if we are using an external memory */
};

/**
 * Actual measurements.
 * This is a list of all the actual measurements of the attached sensors.
 */
extern struct measurement actual_measurements[MAX_EXTERNAL_SENSORS + 1 + MAX_N_VALVES];

extern struct oxycontroller_state actual_state;

#endif /* end of include guard: _ACTUAL_CONDITIONS_H */
```

## include/adc.h
```c
#pragma once
#include "adc.h"
#include "bsp-config.h"
#include <stdint.h>

/**
 * Initialize the analog to digital converter
 */
void adc_init(void);

/**
 * Read the voltage of the battery in mV.
 */
int adc_read_battery(void);

/**
 * Read the supply voltage of the sensor in mV.
 * The Vcc of the external sensor is passed trough a 1/2 divider first and this voltage
 * is passed to the ADC.
 */
int adc_read_sensor_supply(void);

/**
 * Read the supply voltage of the solenoid in mV.
 * The solenoid supply is passed trough a 5.6M/560K voltage divider first,
 * dividing by 11, this goes to a follower and then to the ADC2.
 * We have to multiply by 11 to have mV.
 */
int adc_read_solenoid_supply(void);
```

## include/adcp.h
```c
#ifndef ADCP_h
#define ADCP_h
#define MAX_BEAMS         4
#define MAX_CELLS         129
#define SCALE_FACTOR_1000 1000
#define SCALE_FACTOR_100  100
#define SCALE_FACTOR_10   10
#define SCALE_FACTOR_0_01 0.01
#include <stdint.h>

struct velocity_data {
    int16_t vx;
    int16_t vy;
    int16_t vz;
};

/*
 * ADCP processed data structure. This is more than 1Kbyte long,
 * use with care in embedded microcontrollers.
 */
struct adcp_data {
    int cells;             /* Number of cells */
    int beams;             /* Number of beams */
    int first_cell;        /* First cell not in the blanking zone */
    int depth;             /* Measurement depth (meters) */
    float blanking;        /* Blanking distance in m*/
    float heading;         /* Compass heading (deg)  */
    float pitch;           /* Pitch (deg) */
    float roll;            /* Roll (deg) */
    float temperature;     /* Temperature (deg C) */
    float pressure;        /* Pressure dBar  */
    float cell_size;       /* Cell size in m */
    float battery_voltage; /* Voltage  */
    float vel[MAX_CELLS];  /* Velocity cm/s */
    float dir[MAX_CELLS];  /* Direction deg */
    struct velocity_data vel_earth[MAX_CELLS];
};

/* TODO find a better way to get this data (not global) */
extern struct adcp_data adcp_processed_data;

/**
 * Get a two byte word in Little-Endian into an unsigned integer.
 */
uint16_t le_to_u16(uint8_t *p);

/**
 * Get a four byte word in Little-Endian into an unsigned integer.
 */
uint32_t le_to_u32(uint8_t *p);
#endif /* ADCP_h */
```

## include/bsp-config.h
```c
/**
 *                        bsp-config.h  -  description
 *                            -------------------
 *   begin                : Tue Nov 6 2001
 *   copyright            : (C) 2001 by Pablo Santamarina Cuneo
 *   email                : pablo@santamarina.de
 */

#ifndef BSP_CONFIG_H
#define BSP_CONFIG_H

/**
 * \file
 * Hardware and configuration dependent data.
 * All defines that are hardware or configuration dependent should
 * be defined here in a central place.
 */

#define BOARD_NAME_STRING "Oxycontroller 4"

/* Debug configuration */
#define DEBUG_USE_PRINTK 1

/* General configuration */
#define ANALOG_VCC                 3.3
#define FLUORESCENCE_SAMPLING_RATE 921600.00 /* 1000000 */

/* ADC configuration*/
#define ADC_N_OF_INPUTS  6 /* 4 external + internal Temperature and battery */
#define ADC_MIN_VOLTAGE  0.0
#define ADC_MAX_VOLTAGE  3.3
#define ADC_SCALE_WIDTH  20
#define ADC_SCALE_HEIGHT 90
#define ADC_BITS         12

/* Led configuration */
#define N_OF_LEDS  5
#define LED_STATUS 0 /* The status LED on the board */

/**
 * Digital to analog converter
 */
#define DAC_MAX_VALUE 4095 /* 12 bit dac */

/* The reference resistor should be at least 0.1%. Usually 22.0KOhm */
#define DEFAULT_REFERENCE_RESISTOR 22000.00

/**
 * Serial ports
 */
#define UART_SMART_SENSOR     0 /* Uart to connect the smart sensors */
#define SERIAL_PORT_CABLE     1 /* Cable is connected to UART 3 */
/* Port used for the communication with the user */
#define COMM_UART             SERIAL_PORT_CABLE /* Serial cable port */
#define RS232_PORT            2                 /* Iridium port for RS232 protocol */
/*
 * EEPROM configuration
 */
/* If a magic-key is written here, the bootloader jumps immediately to the application */
#define EE_BOOTLOADER_DISABLE 0x00
/* Configuration variables are stored here */
#define EE_CONFIGURATION      0x04

/* Display configuration */
#define USE_INVERTED_LCD     1   /* Invert the LCD display direction */
#define DISPLAY_ROWS         64  /* Vertical pixels */
#define DISPLAY_COLUMNS      102 /* Horizontal pixels */
#define DISPLAY_STRIDE       13  /* Bytes per one pixel row */
#define DEFAULT_LCD_CONTRAST 40

/* The reference resistor should be at least 0.1%. Usually 22.0KOhm */
#define DEFAULT_REFERENCE_RESISTOR 22000.00

/** The maximum number of external sensors */
#define MAX_EXTERNAL_SENSORS 16
#define MAX_N_VALVES         2

#endif /* BSP_CONFIG_H */
```

## include/comunication.h
```c
#include "smart_sensor.h"
#define RECEIVING      1
#define SLEEPING       0
#define RECEPTION_TIME 1000

void send_data_from_storage(int time_of_last_measurement);
void send_data_from_datalogger(int time_of_last_measurement);
int receiving_commands(char *data);
int is_channel_free(void);
int data_reception(char *data);
int if_received_data(char *data);
int check_acknowledgment(char *data, char *name, int time_of_last_measurement);
void send_ping(void);
void send_adcp_measurements(int time_of_last_measurement, enum sensor_manufacturer sensor_manufacturer);
bool check_for_adcp(void);
```

## include/configuration.h
```c
/***************************************************************************
 *   file                 : configuration.h                                *
 *   begin                : Jul 01, 2019                                   *
 *   copyright            : (C) 2019 by Innovex Tecnologias Ltda.          *
 *   email                : pablo@innovex.cl                               *
 *                                                                         *
 *   This program is property of Innovex Tecnologias Ltda. Chile.          *
 *   Copyright (C) 2019. Innovex.                                          *
 ***************************************************************************/

/*
 * Configuration for the END_DEVICES
 */
#ifndef _CONFIGURATION_H
#define _CONFIGURATION_H

/* #include "motecommand.h" */
#include "measurement.h"
#include "oxygen_control.h"
#include "defaults.h"
#include "bsp-config.h"
#include "smart_sensor.h"

/**
 * Concentrator runtime configuration parameters. This variables are saved into
 * persistent storage.
 */
struct configuration {
    uint8_t channel;
    uint32_t uplink_channel;            /* The Uplink channel of the network */
    uint32_t downlink_channel;          /* The Downlink channel of the network */
    uint16_t sampling_interval;         /* Sampling interval in seconds */
    uint16_t wake_interval;             /* Wake up interval in seconds */
    uint16_t log_interval;              /* Seconds. Write a measurement log entry at this interval */
    uint16_t ping_interval;             /* Interval for pinging the pancoordinator. Seconds */
    char name[10];                      /* Identifier for this device */
    int16_t n_changes;                  /* If the EEPROM/FLASH was empty, we should get -1 here */
    float salinity;                     /* Fixed salinity for saturation concentration */
    float fixed_temperature;            /* Fixed temperature */
    float battery_coefficient;          /* Constant to convert ADC value to battery voltage */
    float v_ref;                        /* Calibrated value of the internal V reference */
    float low_oxygen_alarm;             /* If oxygen goes below this level is an alarm condition */
    float high_oxygen_alarm;            /* If oxygen goes above this level is an alarm condition */
    uint32_t sensor_powerup_time;       /* Time needed by the sensor to power up */
    uint8_t sensor_communication_tries; /* Number of times we try to communicate with a sensor */
    uint8_t lcd_contrast;               /* Contrast of the LCD */
    uint8_t use_saturation;
    enum sensor_type sensor_type[MAX_N_SENSORS];    /* Type of every configured sensor */
    struct valve_configuration valve[MAX_N_VALVES]; /* Configuration of the valves TODO Separate */
    uint16_t version;
    uint8_t command_state;
    uint8_t conductivity_freshwater;
    uint8_t distance;              /* Transmission rate distance */
    uint8_t bandwidth;             /* Lora bandwidth configuration */
    uint8_t datarate;              /* Lora datarate configuration */
    uint16_t time_on_air;          /* Time it takes to transmit */
    float temp_offset;             /* Offset for sensors without temp calibration */
    uint8_t current_sensor_status; /* Current valve sensor |on - off| */
    uint32_t totalized_flow;       /*variable that stores sensor config*/
    uint16_t total_volume;         /* Total volume to calculate percentage */
};

struct sensor_config {
    int16_t n_changes;
    const struct smart_sensor_driver *sensor_driver[SENSOR_MANUFACTURER_END];
};

/*
 * Node configuration. This is global.
 */
extern struct configuration cfg;
extern struct sensor_config sen_drv;

void set_default_configuration(void);
int write_configuration(void);
int write_sensor_configuration(void);
int read_nvs_data(void);
void set_current_time(uint32_t *time);
uint32_t get_current_time(void);
uint32_t get_timestamp(char *data);
void set_driver_default(void);

#endif /* _CONFIGURATION_H */
```

## include/defaults.h
```c
/***************************************************************************
 *   file                 : defaults.h                                     *
 *   begin                : Oct 10, 2011                                   *
 *   copyright            : (C) 2011 by Innovex Tecnologias Ltda.          *
 *   email                : pablo@innovex.cl                               *
 *                                                                         *
 *   This program is property of Innovex Tecnologias Ltda. Chile.          *
 *   Copyright (C) 2011. Innovex.                                          *
 ***************************************************************************/

/*
 * Hardware configuration for the END_DEVICES
 */

#ifndef _DEFAULTS_H
#define _DEFAULTS_H

#define MAX_N_SENSORS 10 /* Maximum 10 sensors attached to this device */

/* Network parameters */
#define DEFAULT_PAN_ID      0XCAFE /* Default PAN-ID */
#define COORDINATOR_ADDRESS 0x0000 /* Short address of the pan-coordinator */

/** Default values for sampling and transmission */
#define DEFAULT_SAMPLING_INTERVAL 30 /* Seconds */
#define DEFAULT_TX_SLOT           0
#define DEFAULT_LOG_INTERVAL      300 /* 5 minutes */

/** Time to have the calibration button pressed to start a calibration */
#define TIME_TO_START_CALIBRATION 5

/** Default values for alarm limits */
#define DEFAULT_LOW_OXYGEN_ALARM_LEVEL             5.0   /* Below this level, ring low oxygen alarm */
#define DEFAULT_HIGH_OXYGEN_ALARM_LEVEL            12.0  /* Above this level, ring high oxygen alarm */
#define DEFAULT_OXYGEN_OPEN_LEVEL                  6.0   /* Below this level, open the oxygen flow */
#define DEFAULT_OXYGEN_CLOSE_LEVEL                 9.0   /* Above this level, close the oxygen flow */
#define DEFAULT_LOW_OXYGEN_SATURATION_ALARM_LEVEL  80.0  /* Below this level, ring low oxygen alarm */
#define DEFAULT_HIGH_OXYGEN_SATURATION_ALARM_LEVEL 120.0 /* Above this level, ring high oxygen alarm */
#define DEFAULT_OXYGEN_SATURATION_OPEN_LEVEL       90.0  /* Below this level, open the oxygen flow */
#define DEFAULT_OXYGEN_SATURATION_CLOSE_LEVEL      95.0  /* Above this level, close the oxygen flow */

/** Default salinity */
#define DEFAULT_SALINITY          0.0
/** Default temperature to use if temperature measurement is invalid */
#define DEFAULT_FIXED_TEMPERATURE 10.0

/**
 * Plausibility limits, if some of the measurements falls outside the ranges specified here,
 * they are marked as not plausible.
 */
#define PLAUSIBLE_MIN_TEMPERATURE 2.0
#define PLAUSIBLE_MAX_TEMPERATURE 32.0
#define PLAUSIBLE_MIN_OXYGEN      0.0
#define PLAUSIBLE_MAX_OXYGEN      20.0
#define PLAUSIBLE_MIN_DEPTH       0.0
#define PLAUSIBLE_MAX_DEPTH       60.0

/**
 * Sensors powering up time in ms
 * TODO This should be in the driver of every sensor.
 */
#define PONSEL_SENSORS_POWERUP_TIME             1000
#define INNOVEX_FLOW_SENSORS_POWERUP_TIME       50
#define INNOVEX_WAVE_SENSORS_POWERUP_TIME       15000
#define INNOVEX_WATER_FLOW_SENSORS_POWERUP_TIME 1000
#define YOSEMITECH_POWERUP_TIME                 22000 /* time to finish cleaning */
#define INNOVEX_SENSORS_POWERUP_TIME            DEFAULT_SENSOR_POWER_UP_TIME
#define AQUAS_SENSORS_POWERUP_TIME              3000
#define LUFFT_POWERUP_TIME                      60000
#define VAISALA_POWERUP_TIME                    10000
#define HUIZHONG_POWERUP_TIME                   6000
#define ANBSENSORS_POWERUP_TIME                 75000
#define XM126_POWERUP_TIME                      1000
#define CHEMINS_POWERUP_TIME                    4000
#define ST_VL53L1X_POWER_TIME                   1000

#define FRESHWATER 0
#define SEAWATER   1

#endif /* _DEFAULTS_H */
```

## include/external_datalogger.h
```c
#ifndef EXTERNAL_DATALOGGER_H
#define EXTERNAL_DATALOGGER_H

int datalogger_mount(void);
uint16_t datalogger_unsended_data_get(void);
void datalogger_unsended_data_flush_last(void);
int datalogger_append(uint8_t *meas_data, size_t size);
int datalogger_get(uint8_t *meas_data, size_t size, uint16_t n_from_last);
void datalogger_format(void);
uint32_t datalogger_get_free_space(void);

#endif /* EXTERNAL_DATALOGGER_H */
```

## include/flowquest.h
```c
/**
 *  \file flowquest.h
 *  \brief Interface definitions for the FlowQuest sensor driver.
 *
 *  \author Raúl Baigorri Morales
 *  \author Sebastián Angulo Oyarzún
 *
 *  \date 18.02.2025
 *
 *  Copyright 2025 Innovex Tecnologías Ltda. All rights reserved.
 */
#ifndef FLOWQUEST_H
#define FLOWQUEST_H

#include <stdint.h>
#include "adcp.h"

#define FLOWQUEST_HEADER_SIZE         8
#define OFFSET_ENSEMBLE_NUMBER        2
#define OFFSET_TEMPERATURE            6
#define OFFSET_BATTERY_VOLTAGE        8
#define OFFSET_NUM_PINGS              10
#define OFFSET_HEADING                18
#define OFFSET_PITCH                  20
#define OFFSET_ROLL                   22
#define OFFSET_ENSEMBLE_OUTPUT_SWITCH 14
#define OFFSET_BIN_LENGTH             32
#define OFFSET_BLANK_DISTANCE         52
#define OFFSET_TRANSDUCER_DEPTH       54
#define OFFSET_ERROR_CODE             56
#define OFFSET_RPH_ABNORMAL           58
#define VALUES_PER_VELOCITY_CELL      3
#define BYTES_PER_TRIPLET_DATA        6
#define BLOCK_HEADER_SIZE             4
#define MIN_COMMON_DATA_SIZE          24
#define COMMON_HEADER_PAYLOAD_SIZE    64

struct adcp_raw_data_flowquest {
    uint16_t ensemble_number;
    uint32_t timestamp;
    uint16_t num_pings;
    uint16_t ensemble_output_switch;
    uint16_t bin_length;
    uint16_t transducer_depth;
    uint16_t blank_distance;
    uint16_t data_length;
    uint16_t cells;
    uint16_t temperature;
    uint16_t heading;
    uint16_t error_code;
    uint16_t rph_abnormal;
    int16_t pitch;
    int16_t roll;
    float battery_voltage;
    float pressure;
    struct velocity_data vel_inst[MAX_CELLS];
    struct velocity_data vel_earth[MAX_CELLS];
};

/**********************************************************
 * Definitions for ADCP FlowQuest
 **********************************************************/

int parse_flowquest_data_frame(int count_receive, uint8_t *frame, struct adcp_raw_data_flowquest *r);

int process_flowquest_raw_data(struct adcp_raw_data_flowquest *r, struct adcp_data *d);

int adcp_cell_count_get(void);

void adcp_cell_count_set(int count);

#endif
```

## include/local_sensors.h
```c
#ifndef LOCAL_SENSORS_H
#define LOCAL_SENSORS_H

#include <stdint.h>

/**
 * @brief Initialize the humidity sensor device
 *
 * @return 0 if successful, negative errno code if failure.
 */
int local_sensors_init(void);

/**
 * @brief Get humidity and temperature readings
 *
 * @param h A ponter to a int16_t, where humidity is stored.
 * @param t A pointer to a float, where temperature is stored.
 *
 * @return 0 if successful, negative errno code if failure.
 */
int local_sensors_get_hum_and_temp(int16_t *h, float *t);

#endif /* end of include guard: LOCAL_SENSORS_H_*/
```

## include/measurement_operations.h
```c
/**
 *  \file measurement_operations.h
 *  \brief Operations with measurements
 *
 *  \author Pablo Santamarina Cuneo
 *  \date 08.02.2019
 *
 *  Copyright 2019 Innovex Tecnologias Ltda. All rights reserved.
 */

#ifndef MEASUREMENT_OPERATIONS_H
#define MEASUREMENT_OPERATIONS_H

#include "measurement.h"

/**
 * Get a pointer to the measurements list
 */
struct measurement *actual_measurement(void);

/**
 * Check if two depths are almost the same.
 */
int almost_same_depth(float depth1, float depth2);

/**
 * Join the salinity measurement from a conductivity sensor at about the same depth
 * of an oxygen sensor.
 * @param n_of_measurements The number of measurements in the array to check
 * @param measurement An array with all the measurements to check.
 * @return the number of oxygen sensors with joined salinity measurements
 */
int measurements_join_oxygen_with_salinity(int n_of_measurements, struct measurement *measurement);

/**
 * Calculate the oxygen concentration for a measurement using the saturation
 * obtained from the optical measurement, the salinity and the temperature
 * The concentration can be calculated only if we have valid oxygen and temperature measurements.
 * @param measurement An array with all the measurements to check.
 * @return 1 if two sensors can be joined, 0 otherwise.
 */
void measurement_calculate_oxygen_concentration(struct measurement *measurement);

/**
 * Calculate the oxygen concentration for a list of measurement using the saturation
 * obtained from the optical measurement, the salinity and the temperature
 * The concentration can be calculated only if we have valid oxygen and temperature measurements.
 * @param n_of_measurements The number of measurements in the array to process
 * @param measurement An array with all the measurements to process.
 */
void measurements_list_calculate_oxygen_concentration(int n_of_measurements, struct measurement *measurement);

/*
 * Join two level measurements.
 * @param n_of_measurements The number of measurements in the array to check
 * @param measurement An array with all the measurements to check.
 * @return 1 if two sensors can be joined.
 */
int measurements_join_two_levels(int n_of_measurements, struct measurement *measurement);

/*
 * Join three current AC measurements.
 * @param n_of_measurements The number of measurements in the array to check
 * @param measurement An array with all the measurements to check.
 * @return 1 if two sensors can be joined.
 */
int measurements_join_current_ac(int n_of_measurements, struct measurement *measurement);

int gets_totalized_flow_measurement(int n_of_measurements, struct measurement *measurement);

/*
 * Average oil level
 */
int average_oil_level(int n_of_measurements, struct measurement *measurement);

#endif /* MEASUREMENT_OPERATIONS_H  */
```

## include/measurement_storage.h
```c
#ifndef MEASUREMENT_STORAGE_H
#define MEASUREMENT_STORAGE_H

int measurement_storage_mount(void);
uint16_t unsended_data_get(void);
void unsended_data_flush_last(void);
int measurement_storage_append(uint8_t *meas_data, size_t size);
int measurement_storage_get(uint8_t *meas_data, size_t size, uint16_t n_from_last);
void measurement_storage_format(void);
uint32_t get_free_space(void);

#endif /* MEASUREMENT_STORAGE_H */
```
